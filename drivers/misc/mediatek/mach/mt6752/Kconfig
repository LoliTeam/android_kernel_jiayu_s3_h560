## drivers/misc/mediatek/mach/mt6752/Kconfig
```kconfig
menu "MTK Support Overclock"

config CPU_OC
	bool "CPU_OVERCLOCK"
	default n
	help
	  Overclock MT6752 to 2 GHz

config GPU_OC
	bool "GPU_OVERCLOCK"
	default n
	help
	  Overclock Mali-T760 to 819 MHz

config MORE_FREQ
	bool "MORE_FREQUENCIES"
	default n
	help
	  More frequencies for choice

endmenu
```
